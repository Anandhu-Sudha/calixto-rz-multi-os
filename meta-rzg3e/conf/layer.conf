## meta-rzg3e/conf/layer.conf
```bitbake
# We have a conf and classes directory, add to BBPATH
BBPATH .= ":${LAYERDIR}"

include ${LAYERDIR}/include/openamp.inc
include ${LAYERDIR}/include/awo.inc

#MACHINE_FEATURES:append = " RZG3E_CM33_BOOT"
#MACHINE_FEATURES:append = " CM33_FIRMWARE_LOAD"
#MACHINE_FEATURES:append = " CM55_CPU_CLOCKUP"

# We have recipes-* directories, add to BBFILES
BBFILES += "${LAYERDIR}/recipes-*/*/*.bb \
            ${LAYERDIR}/recipes-*/*/*.bbappend"
	
BBFILE_COLLECTIONS += "rz-multi-os"
BBFILE_PATTERN_rz-multi-os := "^${LAYERDIR}/"

LAYERDEPENDS_rz-multi-os = "meta-rz-bsp"
LAYERSERIES_COMPAT_rz-multi-os = "scarthgap"
```
